VERSION ""

NS_ :

BS_:

BU_:

BO_ 2617123335 OBC_Input_L2: 8 Vector__XXX
 SG_ OBC_ACVolt_L2 : 16|8@1+ (1,0) [0|0] "Vac" Vector__XXX

BO_ 2617123334 OBC_Input_L1: 8 Vector__XXX
 SG_ OBC_ACVolt_L1 : 16|8@1+ (1,0) [0|0] "Vac" Vector__XXX

BA_DEF_  "BusType" STRING ;
BA_DEF_DEF_  "BusType" "CAN";
